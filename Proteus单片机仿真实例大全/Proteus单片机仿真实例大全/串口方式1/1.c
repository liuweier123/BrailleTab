#include <reg51.h>

//字形码****按列取模
char code table[]={
			0x5E,0x22,0x52,0xAC,0x7E,0xA1,0x52,0xBF,	//‘飘’
			0x7E,0xA8,0xD2,0xA5,0x5E,0x22,0x00,0x04,
			0x7F,0xF8,0x46,0x60,0x41,0x80,0x46,0x60,
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			0x00,0x00,0x00,0x00,0x00,0x00,0x00,0x00
			};

void delay(int c)
	{
	int i,j;
	for(i=0;i<c;i++)
		for(j=0;j<10;j++)
			;
	 }

void main()
	{
	unsigned char i,j,k;	//i:每个字的显示循环；j每个字的显示码除以2；k每列刷新次数
	unsigned char b=0;		//显示偏移控制，char类型最多只能显示14个汉字+一个空白位字符
	unsigned char a;		//控制移动间隔时间
while(1)
	{
	j=0;
	if(a>5)	//移动间隔时间；取值0--255
		{
		a=0;
		b+=2;
		if(b>=160)	//显示到最后一个字，回头显示，判断值=字数*32
			{
			b=0;
			}	
		}
	for(i=0;i<16;i++)
		{
		P1=i;
		for(k=0;k<5;k++)
			{
			P0=table[j+b];
			P2=table[j+b+1];
			delay(2);
			P0=0x00;
			P2=0x00;
			}
		j+=2;
		}
	   	a++;
	}
}

