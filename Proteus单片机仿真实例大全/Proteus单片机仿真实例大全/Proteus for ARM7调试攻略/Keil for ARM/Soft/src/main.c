/****************************************************************************
* File: main.c
* 功能：向LCD输出HelloWorld
****************************************************************************/
#include  "config.h"

#define rs (1<<8)
#define rw (1<<9)
#define en (1<<10)
#define busy (1<<7)

//uint8 txt[]={"HelloWorld"};
uint8 txt[]={"LPC2106 !!"};
/****************************************************************************
* 名称：ChkBusy()
* 功能：检查总线是否忙
****************************************************************************/
void ChkBusy()
{
	IODIR=0x700;
	while(1)
	{
		IOCLR=rs;
		IOSET=rw;
		IOSET=en;
		if(!(IOPIN & busy))break;
		IOCLR=en;
	}
	IODIR=0x7ff;
}
/****************************************************************************
* 名称：WrOp()
* 功能：写函数
****************************************************************************/
void WrOp(uint8 dat)
{
	ChkBusy();
	IOCLR=rs;		//全部清零
	IOCLR=rw;
	IOCLR=0xff;		//先清零
	IOSET=dat;		//再送数
	IOSET=en;
	IOCLR=en;
}
/****************************************************************************
* 名称：WrDat()
* 功能：写数据函数
****************************************************************************/
void WrDat(uint8 dat)	
{
	ChkBusy();
	IOSET=rs;
	IOCLR=rw;
	IOCLR=0xff;		//先清零
	IOSET=dat;		//再送数
	IOSET=en;
	IOCLR=en;
}
/****************************************************************************
* 名称：lcd_init()
* 功能：lcd初始化函数
****************************************************************************/
void lcd_init(void)
{
	WrOp(0x38);			
	WrOp(0x06);			//光标加1
	WrOp(0x0c);			//开显示
}
/****************************************************************************
* 名称：DisText()
* 功能：显示文本函数
****************************************************************************/
void DisText(uint8 addr,uint8 *p)
{
	WrOp(addr);
	while(*p !='\0')WrDat(*(p++));
}

/****************************************************************************
* 名称：main()
* 功能：显示文本
****************************************************************************/

int  main(void)
{   
    lcd_init();
	IODIR=0x7ff;		//设置为输出
	IOCLR=0x7ff;
	
	DisText(0x86,txt);
	while(1);
}
