#include <atmel\regx52.h>

#define int8 unsigned char
#define int16 unsigned int
#define int32 unsigned long 


int8 code num_tab[][8]={
/*--8*8--阴码--逐行扫描--逆向（低位在前）--*/

{0x00,0x00,0x00,0x38,0x44,0x38,0x00,0x00},/*"0",0*/
{0x00,0x00,0x40,0x78,0x48,0x00,0x00,0x00},/*"1",1*/
{0x00,0x00,0x00,0x4C,0x54,0x6C,0x00,0x00},/*"2",2*/
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{0x00,0x00,0x48,0x78,0x68,0x00,0x00,0x00}/*"z",36*/





};

void delay(void);

int8 n;
int8  delta_p;
int8  *p;

void main(void){


int8 i;
int8 j;


p=&num_tab[0][0];

TMOD=0x01;
TH0=0xfc;
TL0=0x18;
ET0=1;
EA=1;
TR0=1;


while(1)
{

   for(i=0;i<8;i++){
	     delay();
	     P0=*(p+delta_p);
         P2=i|0x18;



		 p++;
		 if(p>&num_tab[0][7])
	           p=&num_tab[0][0]; 
     } 
	 	 
}


}
void delay(void){
int16 i;
for(i=0;i<500;i++);

}


void timer0() interrupt 1 using 3
{
    TF0=0;
    TH0=0xfc;
    TL0=0x18;
    if(n<200)
    {
       n++;
    }
    else
    {
	     n=0;
		 if(delta_p>240)
	           delta_p=0; 
		 else
		       delta_p+=2; 
		 
	}
}





















